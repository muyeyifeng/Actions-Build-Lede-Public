## x64-M.defconfig
```kconfig
CONFIG_TARGET_x86=y
CONFIG_TARGET_x86_64=y
CONFIG_TARGET_x86_64_DEVICE_generic=y
CONFIG_ARIA2_BITTORRENT=y
CONFIG_ARIA2_NOXML=y
CONFIG_ARIA2_OPENSSL=y
CONFIG_ARIA2_WEBSOCKET=y
CONFIG_GNUTLS_ALPN=y
CONFIG_GNUTLS_ANON=y
CONFIG_GNUTLS_DTLS_SRTP=y
CONFIG_GNUTLS_HEARTBEAT=y
CONFIG_GNUTLS_OCSP=y
CONFIG_GNUTLS_PSK=y
CONFIG_KSMBD_SMB_INSECURE_SERVER=y
CONFIG_LIBCURL_COOKIES=y
CONFIG_LIBCURL_FILE=y
CONFIG_LIBCURL_FTP=y
CONFIG_LIBCURL_HTTP=y
CONFIG_LIBCURL_MBEDTLS=y
CONFIG_LIBCURL_NO_SMB="!"
CONFIG_LIBCURL_PROXY=y
CONFIG_LIBTINS_ENABLE_CXX11=y
CONFIG_LIBTINS_ENABLE_PCAP=y
CONFIG_LXC_SECCOMP=y
CONFIG_NFS_KERNEL_SERVER_V4=y
CONFIG_NGINX_HEADERS_MORE=y
CONFIG_NGINX_HTTP_ACCESS=y
CONFIG_NGINX_HTTP_AUTH_BASIC=y
CONFIG_NGINX_HTTP_AUTOINDEX=y
CONFIG_NGINX_HTTP_BROWSER=y
CONFIG_NGINX_HTTP_CACHE=y
CONFIG_NGINX_HTTP_CHARSET=y
CONFIG_NGINX_HTTP_EMPTY_GIF=y
CONFIG_NGINX_HTTP_FASTCGI=y
CONFIG_NGINX_HTTP_GEO=y
CONFIG_NGINX_HTTP_GZIP=y
CONFIG_NGINX_HTTP_LIMIT_CONN=y
CONFIG_NGINX_HTTP_LIMIT_REQ=y
CONFIG_NGINX_HTTP_MAP=y
CONFIG_NGINX_HTTP_MEMCACHED=y
CONFIG_NGINX_HTTP_PROXY=y
CONFIG_NGINX_HTTP_REFERER=y
CONFIG_NGINX_HTTP_REWRITE=y
CONFIG_NGINX_HTTP_SCGI=y
CONFIG_NGINX_HTTP_SPLIT_CLIENTS=y
CONFIG_NGINX_HTTP_SSI=y
CONFIG_NGINX_HTTP_UPSTREAM_HASH=y
CONFIG_NGINX_HTTP_UPSTREAM_IP_HASH=y
CONFIG_NGINX_HTTP_UPSTREAM_KEEPALIVE=y
CONFIG_NGINX_HTTP_UPSTREAM_LEAST_CONN=y
CONFIG_NGINX_HTTP_USERID=y
CONFIG_NGINX_HTTP_UWSGI=y
CONFIG_NGINX_NAXSI=y
# CONFIG_NGINX_NOPCRE is not set
CONFIG_NGINX_PCRE=y
CONFIG_NGINX_UBUS=y
CONFIG_OCSERV_HTTP_PARSER=y
CONFIG_OCSERV_PROTOBUF=y
CONFIG_OPENVPN_openssl_ENABLE_DEF_AUTH=y
CONFIG_OPENVPN_openssl_ENABLE_FRAGMENT=y
CONFIG_OPENVPN_openssl_ENABLE_LZ4=y
CONFIG_OPENVPN_openssl_ENABLE_LZO=y
CONFIG_OPENVPN_openssl_ENABLE_MULTIHOME=y
CONFIG_OPENVPN_openssl_ENABLE_PF=y
CONFIG_OPENVPN_openssl_ENABLE_PORT_SHARE=y
CONFIG_OPENVPN_openssl_ENABLE_SERVER=y
CONFIG_OPENVPN_openssl_ENABLE_SMALL=y
CONFIG_PACKAGE_6in4=y
CONFIG_PACKAGE_adblock=m
CONFIG_PACKAGE_ahcpd=m
CONFIG_PACKAGE_alsa-lib=m
CONFIG_PACKAGE_alsa-utils=m
CONFIG_PACKAGE_amule=m
CONFIG_PACKAGE_aria2=y
CONFIG_PACKAGE_ariang=y
CONFIG_PACKAGE_attendedsysupgrade-common=m
CONFIG_PACKAGE_attr=m
CONFIG_PACKAGE_avahi-dbus-daemon=m
CONFIG_PACKAGE_baidupcs-web=y
CONFIG_PACKAGE_bash=y
CONFIG_PACKAGE_bcp38=m
CONFIG_PACKAGE_bird1-ipv4=m
CONFIG_PACKAGE_bird1-ipv4-uci=m
CONFIG_PACKAGE_bird1-ipv6=m
CONFIG_PACKAGE_bird1-ipv6-uci=m
CONFIG_PACKAGE_blkid=m
CONFIG_PACKAGE_bmx6=m
CONFIG_PACKAGE_boost-chrono=y
CONFIG_PACKAGE_boost-random=y
CONFIG_PACKAGE_brook=y
CONFIG_PACKAGE_btrfs-progs=y
CONFIG_PACKAGE_bzip2=m
CONFIG_PACKAGE_ca-bundle=y
CONFIG_PACKAGE_certtool=m
CONFIG_PACKAGE_cgi-io=m
CONFIG_PACKAGE_cgroupfs-mount=y
CONFIG_PACKAGE_chinadns-ng=y
CONFIG_PACKAGE_cjdns=m
CONFIG_PACKAGE_clamav=m
CONFIG_PACKAGE_collectd=m
CONFIG_PACKAGE_collectd-mod-cpu=m
CONFIG_PACKAGE_collectd-mod-interface=m
CONFIG_PACKAGE_collectd-mod-iwinfo=m
CONFIG_PACKAGE_collectd-mod-load=m
CONFIG_PACKAGE_collectd-mod-memory=m
CONFIG_PACKAGE_collectd-mod-network=m
CONFIG_PACKAGE_collectd-mod-rrdtool=m
CONFIG_PACKAGE_confuse=m
CONFIG_PACKAGE_containerd=y
CONFIG_PACKAGE_coreutils-nohup=y
CONFIG_PACKAGE_coreutils-sort=m
CONFIG_PACKAGE_cshark=m
CONFIG_PACKAGE_curl=y
CONFIG_PACKAGE_dbus=m
CONFIG_PACKAGE_dkjson=m
CONFIG_PACKAGE_dnscrypt-proxy=m
CONFIG_PACKAGE_dnscrypt-proxy-resolvers=m
CONFIG_PACKAGE_dnsforwarder=m
CONFIG_PACKAGE_docker-ce=y
CONFIG_PACKAGE_dump1090=m
CONFIG_PACKAGE_dynapoint=m
CONFIG_PACKAGE_e2guardian=m
CONFIG_PACKAGE_fdk-aac=m
CONFIG_PACKAGE_flock=m
CONFIG_PACKAGE_forked-daapd=m
CONFIG_PACKAGE_freifunk-common=m
CONFIG_PACKAGE_freifunk-firewall=m
CONFIG_PACKAGE_freifunk-policyrouting=m
CONFIG_PACKAGE_frpc=y
CONFIG_PACKAGE_frps=y
CONFIG_PACKAGE_fuse-utils=m
CONFIG_PACKAGE_fwknopd=m
CONFIG_PACKAGE_getopt=m
CONFIG_PACKAGE_git=y
CONFIG_PACKAGE_git-http=y
CONFIG_PACKAGE_gzip=y
CONFIG_PACKAGE_haproxy=y
CONFIG_PACKAGE_hd-idle=m
CONFIG_PACKAGE_https-dns-proxy=y
CONFIG_PACKAGE_icu=y
CONFIG_PACKAGE_ip6tables=y
CONFIG_PACKAGE_iptables-mod-conntrack-extra=m
CONFIG_PACKAGE_iptables-mod-extra=y
CONFIG_PACKAGE_iptables-mod-filter=m
CONFIG_PACKAGE_iptables-mod-ipopt=m
CONFIG_PACKAGE_iptables-mod-nat-extra=m
CONFIG_PACKAGE_ipv6helper=y
CONFIG_PACKAGE_kcptun-client=y
CONFIG_PACKAGE_kmod-ac97=m
CONFIG_PACKAGE_kmod-br-netfilter=y
CONFIG_PACKAGE_kmod-crypto-ccm=m
CONFIG_PACKAGE_kmod-crypto-cmac=m
CONFIG_PACKAGE_kmod-crypto-ctr=m
CONFIG_PACKAGE_kmod-crypto-cts=m
CONFIG_PACKAGE_kmod-crypto-gcm=m
CONFIG_PACKAGE_kmod-crypto-gf128=m
CONFIG_PACKAGE_kmod-crypto-ghash=m
CONFIG_PACKAGE_kmod-crypto-md4=m
CONFIG_PACKAGE_kmod-crypto-rng=m
CONFIG_PACKAGE_kmod-crypto-seqiv=m
CONFIG_PACKAGE_kmod-crypto-sha256=m
CONFIG_PACKAGE_kmod-crypto-sha512=m
CONFIG_PACKAGE_kmod-dax=y
CONFIG_PACKAGE_kmod-dm=y
CONFIG_PACKAGE_kmod-dnsresolver=m
CONFIG_PACKAGE_kmod-fs-btrfs=y
CONFIG_PACKAGE_kmod-fs-cifs=m
CONFIG_PACKAGE_kmod-fs-exportfs=m
CONFIG_PACKAGE_kmod-fs-ksmbd=m
CONFIG_PACKAGE_kmod-fs-nfs=m
CONFIG_PACKAGE_kmod-fs-nfs-common=m
CONFIG_PACKAGE_kmod-fs-nfs-common-rpcsec=m
CONFIG_PACKAGE_kmod-fs-nfs-v4=m
CONFIG_PACKAGE_kmod-fs-nfsd=m
CONFIG_PACKAGE_kmod-fuse=m
CONFIG_PACKAGE_kmod-gre=m
CONFIG_PACKAGE_kmod-ifb=m
CONFIG_PACKAGE_kmod-ikconfig=y
CONFIG_PACKAGE_kmod-ip6-tunnel=m
CONFIG_PACKAGE_kmod-ipt-conntrack-extra=m
CONFIG_PACKAGE_kmod-ipt-extra=y
CONFIG_PACKAGE_kmod-ipt-filter=m
CONFIG_PACKAGE_kmod-ipt-ipopt=m
CONFIG_PACKAGE_kmod-ipt-nat-extra=m
CONFIG_PACKAGE_kmod-ipt-nat6=y
CONFIG_PACKAGE_kmod-ipt-offload=m
CONFIG_PACKAGE_kmod-iptunnel=y
CONFIG_PACKAGE_kmod-lib-crc32c=y
CONFIG_PACKAGE_kmod-lib-lzo=y
CONFIG_PACKAGE_kmod-lib-raid6=y
CONFIG_PACKAGE_kmod-lib-xor=y
CONFIG_PACKAGE_kmod-lib-zstd=y
CONFIG_PACKAGE_kmod-nf-flow=m
CONFIG_PACKAGE_kmod-nf-ipvs=y
CONFIG_PACKAGE_kmod-nf-nat6=y
CONFIG_PACKAGE_kmod-nft-bridge=m
CONFIG_PACKAGE_kmod-nft-core=m
CONFIG_PACKAGE_kmod-nft-netdev=m
CONFIG_PACKAGE_kmod-regmap-core=m
CONFIG_PACKAGE_kmod-sched=m
CONFIG_PACKAGE_kmod-sched-cake=m
CONFIG_PACKAGE_kmod-sched-cake-virtual=m
CONFIG_PACKAGE_kmod-sched-connmark=m
CONFIG_PACKAGE_kmod-sched-core=m
CONFIG_PACKAGE_kmod-siit=m
CONFIG_PACKAGE_kmod-sit=y
CONFIG_PACKAGE_kmod-sound-core=m
CONFIG_PACKAGE_kmod-sound-hda-codec-hdmi=m
CONFIG_PACKAGE_kmod-sound-hda-codec-realtek=m
CONFIG_PACKAGE_kmod-sound-hda-codec-via=m
CONFIG_PACKAGE_kmod-sound-hda-core=m
CONFIG_PACKAGE_kmod-sound-hda-intel=m
CONFIG_PACKAGE_kmod-sound-i8x0=m
CONFIG_PACKAGE_kmod-sound-mpu401=m
CONFIG_PACKAGE_kmod-sound-via82xx=m
CONFIG_PACKAGE_kmod-udptunnel4=m
CONFIG_PACKAGE_kmod-udptunnel6=m
CONFIG_PACKAGE_kmod-usb-audio=m
CONFIG_PACKAGE_kmod-usb-ehci=y
CONFIG_PACKAGE_kmod-usb-printer=y
CONFIG_PACKAGE_kmod-usb2=y
CONFIG_PACKAGE_kmod-usb2-pci=y
CONFIG_PACKAGE_kmod-usb3=y
CONFIG_PACKAGE_kmod-veth=y
CONFIG_PACKAGE_kmod-wireguard=m
CONFIG_PACKAGE_ksmbd-server=m
CONFIG_PACKAGE_lame-lib=m
CONFIG_PACKAGE_libantlr3c=m
CONFIG_PACKAGE_libao=m
CONFIG_PACKAGE_libattr=y
CONFIG_PACKAGE_libavahi-client=m
CONFIG_PACKAGE_libavahi-compat-libdnssd=m
CONFIG_PACKAGE_libavahi-dbus-support=m
CONFIG_PACKAGE_libbfd=m
CONFIG_PACKAGE_libbz2=y
CONFIG_PACKAGE_libcap=y
CONFIG_PACKAGE_libconfig=m
CONFIG_PACKAGE_libcryptopp=m
CONFIG_PACKAGE_libcurl=y
CONFIG_PACKAGE_libdaemon=m
CONFIG_PACKAGE_libdb47=y
CONFIG_PACKAGE_libdbus=m
CONFIG_PACKAGE_libdevmapper=y
CONFIG_PACKAGE_libdouble-conversion=y
CONFIG_PACKAGE_libedit=m
CONFIG_PACKAGE_libexif=m
CONFIG_PACKAGE_libexpat=m
CONFIG_PACKAGE_libffi=y
CONFIG_PACKAGE_libffmpeg-full=m
CONFIG_PACKAGE_libfko=m
CONFIG_PACKAGE_libflac=m
CONFIG_PACKAGE_libfreetype=y
CONFIG_PACKAGE_libfuse=m
CONFIG_PACKAGE_libgcrypt=m
CONFIG_PACKAGE_libgd=m
CONFIG_PACKAGE_libgd-full=y
CONFIG_PACKAGE_libgdbm=y
CONFIG_PACKAGE_libgnutls=y
CONFIG_PACKAGE_libgpg-error=m
CONFIG_PACKAGE_libiconv-full=m
CONFIG_PACKAGE_libid3tag=m
CONFIG_PACKAGE_libjpeg-turbo=y
CONFIG_PACKAGE_libkeyutils=m
CONFIG_PACKAGE_libltdl=y
CONFIG_PACKAGE_liblua5.3=y
CONFIG_PACKAGE_liblxc=m
CONFIG_PACKAGE_liblzma=y
CONFIG_PACKAGE_liblzo=y
CONFIG_PACKAGE_libmilter-sendmail=m
CONFIG_PACKAGE_libmount=y
CONFIG_PACKAGE_libnetfilter-conntrack=m
CONFIG_PACKAGE_libnettle=y
CONFIG_PACKAGE_libnetwork=y
CONFIG_PACKAGE_libnfnetlink=m
CONFIG_PACKAGE_libnftnl=m
CONFIG_PACKAGE_libnl-core=m
CONFIG_PACKAGE_libnl-genl=m
CONFIG_PACKAGE_libnss=y
CONFIG_PACKAGE_libogg=m
CONFIG_PACKAGE_libopus=m
CONFIG_PACKAGE_libpagekite=m
CONFIG_PACKAGE_libpam=m
CONFIG_PACKAGE_libpcap=m
CONFIG_PACKAGE_libpcre2=y
CONFIG_PACKAGE_libpcre2-16=y
CONFIG_PACKAGE_libplist=m
CONFIG_PACKAGE_libpng=y
CONFIG_PACKAGE_libpopt=m
CONFIG_PACKAGE_libprotobuf-c=m
CONFIG_PACKAGE_libqrencode=m
CONFIG_PACKAGE_librrd1=m
CONFIG_PACKAGE_librtlsdr=m
CONFIG_PACKAGE_libseccomp=m
CONFIG_PACKAGE_libsoxr=m
CONFIG_PACKAGE_libsqlite3=y
CONFIG_PACKAGE_libtasn1=m
CONFIG_PACKAGE_libtiff=y
CONFIG_PACKAGE_libtins=m
CONFIG_PACKAGE_libtirpc=m
CONFIG_PACKAGE_libubox-lua=m
CONFIG_PACKAGE_libunbound=m
CONFIG_PACKAGE_libunbound_ipset=y
CONFIG_PACKAGE_libunbound_libevent=y
CONFIG_PACKAGE_libunbound_libpthread=y
CONFIG_PACKAGE_libunistring=m
CONFIG_PACKAGE_libupnp=m
CONFIG_PACKAGE_libusb-1.0=m
CONFIG_PACKAGE_libustream-mbedtls=m
CONFIG_PACKAGE_libvorbis=m
CONFIG_PACKAGE_libwebp=y
CONFIG_PACKAGE_libwebsockets-full=y
CONFIG_PACKAGE_libwrap=m
CONFIG_PACKAGE_libwxbase=m
CONFIG_PACKAGE_libxml2=y
CONFIG_PACKAGE_libyaml=y
CONFIG_PACKAGE_libyaml-cpp=m
CONFIG_PACKAGE_libzip-gnutls=y
CONFIG_PACKAGE_libzstd=y
CONFIG_PACKAGE_lua-bencode=m
CONFIG_PACKAGE_lua-sha2=m
CONFIG_PACKAGE_luasocket=m
CONFIG_PACKAGE_luci-app-adblock=m
CONFIG_PACKAGE_luci-app-advanced-reboot=y
CONFIG_PACKAGE_luci-app-ahcp=m
CONFIG_PACKAGE_luci-app-airplay2=m
CONFIG_PACKAGE_luci-app-amule=m
CONFIG_PACKAGE_luci-app-aria2=y
CONFIG_PACKAGE_luci-app-asterisk=m
CONFIG_PACKAGE_luci-app-attendedsysupgrade=m
CONFIG_PACKAGE_luci-app-baidupcs-web=y
CONFIG_PACKAGE_luci-app-bcp38=m
CONFIG_PACKAGE_luci-app-bird1-ipv4=m
CONFIG_PACKAGE_luci-app-bird1-ipv6=m
CONFIG_PACKAGE_luci-app-bmx6=m
CONFIG_PACKAGE_luci-app-cifs-mount=m
CONFIG_PACKAGE_luci-app-cifsd=m
CONFIG_PACKAGE_luci-app-cjdns=m
CONFIG_PACKAGE_luci-app-clamav=m
CONFIG_PACKAGE_luci-app-commands=m
CONFIG_PACKAGE_luci-app-control-timewol=m
CONFIG_PACKAGE_luci-app-control-webrestriction=m
CONFIG_PACKAGE_luci-app-control-weburl=m
CONFIG_PACKAGE_luci-app-cshark=m
CONFIG_PACKAGE_luci-app-diag-core=m
CONFIG_PACKAGE_luci-app-diskman=m
CONFIG_PACKAGE_luci-app-dnscrypt-proxy=m
CONFIG_PACKAGE_luci-app-dnsforwarder=m
CONFIG_PACKAGE_luci-app-docker=y
CONFIG_PACKAGE_luci-app-dump1090=m
CONFIG_PACKAGE_luci-app-dynapoint=m
CONFIG_PACKAGE_luci-app-e2guardian=m
CONFIG_PACKAGE_luci-app-familycloud=y
CONFIG_PACKAGE_luci-app-fileassistant=m
CONFIG_PACKAGE_luci-app-filebrowser=y
CONFIG_PACKAGE_luci-app-flowoffload=m
CONFIG_PACKAGE_luci-app-freifunk-diagnostics=m
CONFIG_PACKAGE_luci-app-freifunk-policyrouting=m
CONFIG_PACKAGE_luci-app-freifunk-widgets=m
CONFIG_PACKAGE_luci-app-frpc=y
CONFIG_PACKAGE_luci-app-frps=y
CONFIG_PACKAGE_luci-app-fwknopd=m
CONFIG_PACKAGE_luci-app-guest-wifi=m
CONFIG_PACKAGE_luci-app-haproxy-tcp=m
CONFIG_PACKAGE_luci-app-hd-idle=m
CONFIG_PACKAGE_luci-app-hnet=m
CONFIG_PACKAGE_luci-app-https-dns-proxy=m
CONFIG_PACKAGE_luci-app-ipsec-server=m
CONFIG_PACKAGE_luci-app-kodexplorer=y
CONFIG_PACKAGE_luci-app-lxc=m
CONFIG_PACKAGE_luci-app-meshwizard=m
CONFIG_PACKAGE_luci-app-minidlna=m
CONFIG_PACKAGE_luci-app-mjpg-streamer=m
CONFIG_PACKAGE_luci-app-music-remote-center=m
CONFIG_PACKAGE_luci-app-mwan3=m
CONFIG_PACKAGE_luci-app-mwan3helper=m
CONFIG_PACKAGE_luci-app-n2n_v2=m
CONFIG_PACKAGE_luci-app-netdata=y
CONFIG_PACKAGE_luci-app-nfs=m
CONFIG_PACKAGE_luci-app-nft-qos=m
CONFIG_PACKAGE_luci-app-nginx-pingos=m
CONFIG_PACKAGE_luci-app-noddos=m
CONFIG_PACKAGE_luci-app-nps=m
CONFIG_PACKAGE_luci-app-ntpc=m
CONFIG_PACKAGE_luci-app-ocserv=m
CONFIG_PACKAGE_luci-app-olsr=m
CONFIG_PACKAGE_luci-app-olsr-services=m
CONFIG_PACKAGE_luci-app-olsr-viz=m
CONFIG_PACKAGE_luci-app-openvpn=m
CONFIG_PACKAGE_luci-app-openvpn-server=m
CONFIG_PACKAGE_luci-app-p910nd=m
CONFIG_PACKAGE_luci-app-pagekitec=m
CONFIG_PACKAGE_luci-app-passwall=y
CONFIG_PACKAGE_luci-app-passwall_INCLUDE_Brook=y
CONFIG_PACKAGE_luci-app-passwall_INCLUDE_ChinaDNS_NG=y
CONFIG_PACKAGE_luci-app-passwall_INCLUDE_NaiveProxy=y
CONFIG_PACKAGE_luci-app-passwall_INCLUDE_V2ray=y
CONFIG_PACKAGE_luci-app-passwall_INCLUDE_dns2socks=y
CONFIG_PACKAGE_luci-app-passwall_INCLUDE_kcptun=y
CONFIG_PACKAGE_luci-app-polipo=m
CONFIG_PACKAGE_luci-app-pppoe-relay=m
CONFIG_PACKAGE_luci-app-pppoe-server=m
CONFIG_PACKAGE_luci-app-pptp-server=m
CONFIG_PACKAGE_luci-app-privoxy=m
CONFIG_PACKAGE_luci-app-ps3netsrv=m
CONFIG_PACKAGE_luci-app-qbittorrent=y
CONFIG_PACKAGE_luci-app-qos=m
CONFIG_PACKAGE_luci-app-radicale=m
CONFIG_PACKAGE_luci-app-rclone=m
CONFIG_PACKAGE_luci-app-rp-pppoe-server=m
CONFIG_PACKAGE_luci-app-samba4=m
CONFIG_PACKAGE_luci-app-shadowsocks-libev=m
CONFIG_PACKAGE_luci-app-shairplay=m
CONFIG_PACKAGE_luci-app-siitwizard=m
CONFIG_PACKAGE_luci-app-simple-adblock=m
CONFIG_PACKAGE_luci-app-socat=m
CONFIG_PACKAGE_luci-app-softethervpn=m
CONFIG_PACKAGE_luci-app-splash=m
CONFIG_PACKAGE_luci-app-sqm=m
CONFIG_PACKAGE_luci-app-squid=m
CONFIG_PACKAGE_luci-app-ssr-mudb-server=m
CONFIG_PACKAGE_luci-app-ssr-plus_INCLUDE_Kcptun=y
CONFIG_PACKAGE_luci-app-ssr-plus_INCLUDE_NaiveProxy=y
CONFIG_PACKAGE_luci-app-ssr-plus_INCLUDE_V2ray=y
CONFIG_PACKAGE_luci-app-ssrserver-python=m
CONFIG_PACKAGE_luci-app-statistics=m
CONFIG_PACKAGE_luci-app-syncdial=m
CONFIG_PACKAGE_luci-app-syncthing=m
CONFIG_PACKAGE_luci-app-timecontrol=m
CONFIG_PACKAGE_luci-app-tinyproxy=m
CONFIG_PACKAGE_luci-app-transmission=y
CONFIG_PACKAGE_luci-app-travelmate=m
CONFIG_PACKAGE_luci-app-ttyd=y
CONFIG_PACKAGE_luci-app-udpxy=m
CONFIG_PACKAGE_luci-app-uhttpd=y
CONFIG_PACKAGE_luci-app-unbound=m
CONFIG_PACKAGE_luci-app-usb-printer=y
CONFIG_PACKAGE_luci-app-v2ray-server=m
CONFIG_PACKAGE_luci-app-verysync=m
CONFIG_PACKAGE_luci-app-vnstat=m
CONFIG_PACKAGE_luci-app-vpnbypass=m
CONFIG_PACKAGE_luci-app-watchcat=y
CONFIG_PACKAGE_luci-app-wifischedule=m
CONFIG_PACKAGE_luci-app-wireguard=m
CONFIG_PACKAGE_luci-app-wrtbwmon=m
CONFIG_PACKAGE_luci-i18n-adblock-zh-cn=m
CONFIG_PACKAGE_luci-i18n-advanced-reboot-zh-cn=y
CONFIG_PACKAGE_luci-i18n-ahcp-zh-cn=m
CONFIG_PACKAGE_luci-i18n-airplay2-zh-cn=m
CONFIG_PACKAGE_luci-i18n-amule-zh-cn=m
CONFIG_PACKAGE_luci-i18n-aria2-zh-cn=y
CONFIG_PACKAGE_luci-i18n-asterisk-zh-cn=m
CONFIG_PACKAGE_luci-i18n-bcp38-zh-cn=m
CONFIG_PACKAGE_luci-i18n-cifs-mount-zh-cn=m
CONFIG_PACKAGE_luci-i18n-cifsd-zh-cn=m
CONFIG_PACKAGE_luci-i18n-clamav-zh-cn=m
CONFIG_PACKAGE_luci-i18n-commands-zh-cn=m
CONFIG_PACKAGE_luci-i18n-control-timewol-zh-cn=m
CONFIG_PACKAGE_luci-i18n-control-webrestriction-zh-cn=m
CONFIG_PACKAGE_luci-i18n-control-weburl-zh-cn=m
CONFIG_PACKAGE_luci-i18n-diag-core-zh-cn=m
CONFIG_PACKAGE_luci-i18n-dnsforwarder-zh-cn=m
CONFIG_PACKAGE_luci-i18n-docker-zh-cn=y
CONFIG_PACKAGE_luci-i18n-filebrowser-zh-cn=y
CONFIG_PACKAGE_luci-i18n-flowoffload-zh-cn=m
CONFIG_PACKAGE_luci-i18n-freifunk-policyrouting-zh-cn=m
CONFIG_PACKAGE_luci-i18n-freifunk-zh-cn=m
CONFIG_PACKAGE_luci-i18n-frpc-zh-cn=y
CONFIG_PACKAGE_luci-i18n-frps-zh-cn=y
CONFIG_PACKAGE_luci-i18n-guest-wifi-zh-cn=m
CONFIG_PACKAGE_luci-i18n-haproxy-tcp-zh-cn=m
CONFIG_PACKAGE_luci-i18n-hd-idle-zh-cn=m
CONFIG_PACKAGE_luci-i18n-ipsec-server-zh-cn=m
CONFIG_PACKAGE_luci-i18n-kodexplorer-zh-cn=y
CONFIG_PACKAGE_luci-i18n-meshwizard-zh-cn=m
CONFIG_PACKAGE_luci-i18n-minidlna-zh-cn=m
CONFIG_PACKAGE_luci-i18n-mjpg-streamer-zh-cn=m
CONFIG_PACKAGE_luci-i18n-music-remote-center-zh-cn=m
CONFIG_PACKAGE_luci-i18n-mwan3-zh-cn=m
CONFIG_PACKAGE_luci-i18n-mwan3helper-zh-cn=m
CONFIG_PACKAGE_luci-i18n-n2n_v2-zh-cn=m
CONFIG_PACKAGE_luci-i18n-netdata-zh-cn=y
CONFIG_PACKAGE_luci-i18n-nfs-zh-cn=m
CONFIG_PACKAGE_luci-i18n-nft-qos-zh-cn=m
CONFIG_PACKAGE_luci-i18n-nps-zh-cn=m
CONFIG_PACKAGE_luci-i18n-ntpc-zh-cn=m
CONFIG_PACKAGE_luci-i18n-olsr-zh-cn=m
CONFIG_PACKAGE_luci-i18n-openvpn-server-zh-cn=m
CONFIG_PACKAGE_luci-i18n-openvpn-zh-cn=m
CONFIG_PACKAGE_luci-i18n-p910nd-zh-cn=m
CONFIG_PACKAGE_luci-i18n-polipo-zh-cn=m
CONFIG_PACKAGE_luci-i18n-pppoe-relay-zh-cn=m
CONFIG_PACKAGE_luci-i18n-pppoe-server-zh-cn=m
CONFIG_PACKAGE_luci-i18n-pptp-server-zh-cn=m
CONFIG_PACKAGE_luci-i18n-privoxy-zh-cn=m
CONFIG_PACKAGE_luci-i18n-ps3netsrv-zh-cn=m
CONFIG_PACKAGE_luci-i18n-qbittorrent-zh-cn=y
CONFIG_PACKAGE_luci-i18n-qos-zh-cn=m
CONFIG_PACKAGE_luci-i18n-rclone-zh-cn=m
CONFIG_PACKAGE_luci-i18n-samba4-zh-cn=m
CONFIG_PACKAGE_luci-i18n-socat-zh-cn=m
CONFIG_PACKAGE_luci-i18n-softethervpn-zh-cn=m
CONFIG_PACKAGE_luci-i18n-splash-zh-cn=m
CONFIG_PACKAGE_luci-i18n-sqm-zh-cn=m
CONFIG_PACKAGE_luci-i18n-ssr-mudb-server-zh-cn=m
CONFIG_PACKAGE_luci-i18n-ssrserver-python-zh-cn=m
CONFIG_PACKAGE_luci-i18n-statistics-zh-cn=m
CONFIG_PACKAGE_luci-i18n-syncthing-zh-cn=m
CONFIG_PACKAGE_luci-i18n-timecontrol-zh-cn=m
CONFIG_PACKAGE_luci-i18n-tinyproxy-zh-cn=m
CONFIG_PACKAGE_luci-i18n-transmission-zh-cn=y
CONFIG_PACKAGE_luci-i18n-ttyd-zh-cn=y
CONFIG_PACKAGE_luci-i18n-uhttpd-zh-cn=y
CONFIG_PACKAGE_luci-i18n-usb-printer-zh-cn=y
CONFIG_PACKAGE_luci-i18n-v2ray-server-zh-cn=m
CONFIG_PACKAGE_luci-i18n-verysync-zh-cn=m
CONFIG_PACKAGE_luci-i18n-vnstat-zh-cn=m
CONFIG_PACKAGE_luci-i18n-vpnbypass-zh-cn=m
CONFIG_PACKAGE_luci-i18n-watchcat-zh-cn=y
CONFIG_PACKAGE_luci-i18n-wifischedule-zh-cn=m
CONFIG_PACKAGE_luci-i18n-wireguard-zh-cn=m
CONFIG_PACKAGE_luci-i18n-wrtbwmon-zh-cn=m
CONFIG_PACKAGE_luci-lib-dracula=m
CONFIG_PACKAGE_luci-lib-httpclient=m
CONFIG_PACKAGE_luci-lib-httpprotoutils=m
CONFIG_PACKAGE_luci-lib-jquery-1-4=m
CONFIG_PACKAGE_luci-lib-json=m
CONFIG_PACKAGE_luci-lib-luaneightbl=m
CONFIG_PACKAGE_luci-mod-freifunk=m
CONFIG_PACKAGE_luci-proto-ipv6=y
CONFIG_PACKAGE_luci-proto-wireguard=m
CONFIG_PACKAGE_luci-theme-argon=y
CONFIG_PACKAGE_luci-theme-freifunk-generic=y
CONFIG_PACKAGE_luci-theme-material=y
CONFIG_PACKAGE_luci-theme-netgear=y
CONFIG_PACKAGE_lxc=m
CONFIG_PACKAGE_lxc-attach=m
CONFIG_PACKAGE_lxc-common=m
CONFIG_PACKAGE_lxc-configs=m
CONFIG_PACKAGE_lxc-console=m
CONFIG_PACKAGE_lxc-create=m
CONFIG_PACKAGE_lxc-hooks=m
CONFIG_PACKAGE_lxc-templates=m
CONFIG_PACKAGE_meshwizard=m
CONFIG_PACKAGE_minidlna=m
CONFIG_PACKAGE_mjpg-streamer=m
CONFIG_PACKAGE_mount-utils=y
CONFIG_PACKAGE_musl-fts=m
CONFIG_PACKAGE_mwan3=m
CONFIG_PACKAGE_mxml=m
CONFIG_PACKAGE_n2n-edge=m
CONFIG_PACKAGE_n2n-supernode=m
CONFIG_PACKAGE_naiveproxy=y
CONFIG_PACKAGE_netdata=y
CONFIG_PACKAGE_nfs-kernel-server=m
CONFIG_PACKAGE_nfs-kernel-server-utils=m
CONFIG_PACKAGE_nfs-utils=m
CONFIG_PACKAGE_nfs-utils-libs=m
CONFIG_PACKAGE_nft-qos=m
CONFIG_PACKAGE_nftables-nojson=m
CONFIG_PACKAGE_nginx-ssl=y
CONFIG_PACKAGE_nginx-ssl-util=y
CONFIG_PACKAGE_noddos=m
CONFIG_PACKAGE_npc=m
CONFIG_PACKAGE_nspr=y
CONFIG_PACKAGE_ntpclient=m
CONFIG_PACKAGE_ocserv=m
CONFIG_PACKAGE_odhcp6c=y
CONFIG_PACKAGE_odhcp6c_ext_cer_id=0
CONFIG_PACKAGE_odhcpd-ipv6only=y
CONFIG_PACKAGE_odhcpd_ipv6only_ext_cer_id=0
CONFIG_PACKAGE_olsrd=m
CONFIG_PACKAGE_olsrd-mod-jsoninfo=m
CONFIG_PACKAGE_olsrd-mod-nameservice=m
CONFIG_PACKAGE_olsrd-mod-txtinfo=m
CONFIG_PACKAGE_oniguruma=y
CONFIG_PACKAGE_openvpn-easy-rsa=m
CONFIG_PACKAGE_openvpn-openssl=m
CONFIG_PACKAGE_p910nd=y
CONFIG_PACKAGE_pagekitec=m
CONFIG_PACKAGE_parted=m
CONFIG_PACKAGE_php7=y
CONFIG_PACKAGE_php7-fpm=y
CONFIG_PACKAGE_php7-mod-curl=y
CONFIG_PACKAGE_php7-mod-gd=y
CONFIG_PACKAGE_php7-mod-iconv=y
CONFIG_PACKAGE_php7-mod-json=y
CONFIG_PACKAGE_php7-mod-mbstring=y
CONFIG_PACKAGE_php7-mod-mysqlnd=y
CONFIG_PACKAGE_php7-mod-opcache=y
CONFIG_PACKAGE_php7-mod-pdo=y
CONFIG_PACKAGE_php7-mod-pdo-mysql=y
CONFIG_PACKAGE_php7-mod-pdo-sqlite=y
CONFIG_PACKAGE_php7-mod-session=y
CONFIG_PACKAGE_php7-mod-sqlite3=y
CONFIG_PACKAGE_php7-mod-zip=y
CONFIG_PACKAGE_polipo=m
CONFIG_PACKAGE_pptpd=m
CONFIG_PACKAGE_privoxy=m
CONFIG_PACKAGE_ps3netsrv=m
CONFIG_PACKAGE_python-pip-conf=y
CONFIG_PACKAGE_python3=y
CONFIG_PACKAGE_python3-asyncio=y
CONFIG_PACKAGE_python3-base=y
CONFIG_PACKAGE_python3-certifi=y
CONFIG_PACKAGE_python3-cgi=y
CONFIG_PACKAGE_python3-cgitb=y
CONFIG_PACKAGE_python3-chardet=y
CONFIG_PACKAGE_python3-codecs=y
CONFIG_PACKAGE_python3-ctypes=y
CONFIG_PACKAGE_python3-dbm=y
CONFIG_PACKAGE_python3-decimal=y
CONFIG_PACKAGE_python3-distutils=y
CONFIG_PACKAGE_python3-email=y
CONFIG_PACKAGE_python3-gdbm=y
CONFIG_PACKAGE_python3-idna=y
CONFIG_PACKAGE_python3-light=y
CONFIG_PACKAGE_python3-logging=y
CONFIG_PACKAGE_python3-lzma=y
CONFIG_PACKAGE_python3-multiprocessing=y
CONFIG_PACKAGE_python3-ncurses=y
CONFIG_PACKAGE_python3-openssl=y
CONFIG_PACKAGE_python3-pip=y
CONFIG_PACKAGE_python3-pkg-resources=y
CONFIG_PACKAGE_python3-pydoc=y
CONFIG_PACKAGE_python3-requests=y
CONFIG_PACKAGE_python3-setuptools=y
CONFIG_PACKAGE_python3-sqlite3=y
CONFIG_PACKAGE_python3-unittest=y
CONFIG_PACKAGE_python3-urllib=y
CONFIG_PACKAGE_python3-urllib3=y
CONFIG_PACKAGE_python3-xml=y
CONFIG_PACKAGE_qBittorrent=y
CONFIG_PACKAGE_qos-scripts=m
CONFIG_PACKAGE_qrencode=m
CONFIG_PACKAGE_qt5-core=y
CONFIG_PACKAGE_qt5-network=y
CONFIG_PACKAGE_qt5-sql=y
CONFIG_PACKAGE_qt5-xml=y
CONFIG_PACKAGE_rblibtorrent=y
CONFIG_PACKAGE_rclone=m
CONFIG_PACKAGE_rclone-ng=m
CONFIG_PACKAGE_rclone-webui-react=m
CONFIG_PACKAGE_rp-pppoe-common=m
CONFIG_PACKAGE_rp-pppoe-relay=m
CONFIG_PACKAGE_rp-pppoe-server=m
CONFIG_PACKAGE_rpcbind=m
CONFIG_PACKAGE_rpcd-mod-lxc=m
CONFIG_PACKAGE_rpcd-mod-rpcsys=m
CONFIG_PACKAGE_rrdtool1=m
CONFIG_PACKAGE_runc=y
CONFIG_PACKAGE_samba4-libs=m
CONFIG_PACKAGE_samba4-server=m
CONFIG_PACKAGE_screen=y
CONFIG_PACKAGE_shadowsocks-libev-ss-server=y
CONFIG_PACKAGE_shairplay=m
CONFIG_PACKAGE_shairport-sync-openssl=m
CONFIG_PACKAGE_simple-adblock=m
CONFIG_PACKAGE_smartmontools=m
CONFIG_PACKAGE_socat=m
CONFIG_PACKAGE_softethervpn5-bridge=m
CONFIG_PACKAGE_softethervpn5-client=m
CONFIG_PACKAGE_softethervpn5-libs=m
CONFIG_PACKAGE_softethervpn5-server=m
CONFIG_PACKAGE_sqlite3-cli=m
CONFIG_PACKAGE_sqm-scripts=m
CONFIG_PACKAGE_squid=m
CONFIG_PACKAGE_ssocks=y
CONFIG_PACKAGE_syncthing=m
CONFIG_PACKAGE_tc=m
CONFIG_PACKAGE_tini=y
CONFIG_PACKAGE_tinyproxy=m
CONFIG_PACKAGE_transmission-daemon-openssl=y
CONFIG_PACKAGE_transmission-web-control=y
CONFIG_PACKAGE_travelmate=m
CONFIG_PACKAGE_trojan-go=y
CONFIG_PACKAGE_trojan-plus=y
CONFIG_PACKAGE_ttyd=y
CONFIG_PACKAGE_uclibcxx=m
CONFIG_PACKAGE_udpxy=m
CONFIG_PACKAGE_unbound-daemon=m
CONFIG_PACKAGE_unzip=y
CONFIG_PACKAGE_v2ray=y
CONFIG_PACKAGE_verysync=m
CONFIG_PACKAGE_vim-full=y
CONFIG_PACKAGE_vnstat=m
CONFIG_PACKAGE_vnstati=m
CONFIG_PACKAGE_vpnbypass=m
CONFIG_PACKAGE_watchcat=y
CONFIG_PACKAGE_webui-aria2=y
CONFIG_PACKAGE_wifischedule=m
CONFIG_PACKAGE_wireguard-tools=y
CONFIG_PACKAGE_zoneinfo-asia=y
CONFIG_PACKAGE_zsh=y
CONFIG_PCRE2_JIT_ENABLED=y
CONFIG_RPCBIND_LIBWRAP=y
CONFIG_RPCBIND_RMTCALLS=y
CONFIG_SAMBA4_SERVER_AVAHI=y
CONFIG_SAMBA4_SERVER_NETBIOS=y
CONFIG_SAMBA4_SERVER_VFS=y
CONFIG_SQLITE3_DYNAMIC_EXTENSIONS=y
CONFIG_SQLITE3_FTS3=y
CONFIG_SQLITE3_FTS4=y
CONFIG_SQLITE3_FTS5=y
CONFIG_SQLITE3_JSON1=y
CONFIG_SQLITE3_LIBEDIT=y
CONFIG_SQLITE3_RTREE=y
CONFIG_SQUID_enable-dlmalloc=y
CONFIG_SQUID_enable-ipv6=y
CONFIG_SQUID_use-openssl=y
CONFIG_TARGET_EXT4_BLOCKSIZE=4096
CONFIG_TARGET_EXT4_BLOCKSIZE_4K=y
CONFIG_TARGET_EXT4_RESERVED_PCT=0
CONFIG_TARGET_KERNEL_PARTSIZE=50
CONFIG_TARGET_ROOTFS_EXT4FS=y
CONFIG_TARGET_ROOTFS_PARTSIZE=500
CONFIG_TARGET_ROOTFS_TARGZ=y
CONFIG_TROJAN_GO_COMPRESS_UPX=y
CONFIG_V2RAY_COMPRESS_UPX=y
CONFIG_V2RAY_EXCLUDE_ASSETS=y
CONFIG_V2RAY_EXCLUDE_V2CTL=y
CONFIG_ZSTD_OPTIMIZE_O3=y
```
