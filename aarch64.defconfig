## rpi464_M.defconfig
```kconfig
CONFIG_TARGET_bcm27xx=y
CONFIG_TARGET_bcm27xx_bcm2711=y
CONFIG_TARGET_bcm27xx_bcm2711_DEVICE_rpi-4=y
CONFIG_ARIA2_BITTORRENT=y
CONFIG_ARIA2_NOXML=y
CONFIG_ARIA2_OPENSSL=y
CONFIG_ARIA2_WEBSOCKET=y
CONFIG_GNUTLS_ALPN=y
CONFIG_GNUTLS_ANON=y
CONFIG_GNUTLS_DTLS_SRTP=y
CONFIG_GNUTLS_HEARTBEAT=y
CONFIG_GNUTLS_OCSP=y
CONFIG_GNUTLS_PSK=y
CONFIG_KSMBD_SMB_INSECURE_SERVER=y
CONFIG_LIBCURL_COOKIES=y
CONFIG_LIBCURL_FILE=y
CONFIG_LIBCURL_FTP=y
CONFIG_LIBCURL_HTTP=y
CONFIG_LIBCURL_MBEDTLS=y
CONFIG_LIBCURL_NO_SMB="!"
CONFIG_LIBCURL_PROXY=y
CONFIG_LIBTINS_ENABLE_CXX11=y
CONFIG_LIBTINS_ENABLE_PCAP=y
CONFIG_LXC_SECCOMP=y
CONFIG_NFS_KERNEL_SERVER_V4=y
CONFIG_NGINX_HEADERS_MORE=y
CONFIG_NGINX_HTTP_ACCESS=y
CONFIG_NGINX_HTTP_AUTH_BASIC=y
CONFIG_NGINX_HTTP_AUTOINDEX=y
CONFIG_NGINX_HTTP_BROWSER=y
CONFIG_NGINX_HTTP_CACHE=y
CONFIG_NGINX_HTTP_CHARSET=y
CONFIG_NGINX_HTTP_EMPTY_GIF=y
CONFIG_NGINX_HTTP_FASTCGI=y
CONFIG_NGINX_HTTP_GEO=y
CONFIG_NGINX_HTTP_GZIP=y
CONFIG_NGINX_HTTP_LIMIT_CONN=y
CONFIG_NGINX_HTTP_LIMIT_REQ=y
CONFIG_NGINX_HTTP_MAP=y
CONFIG_NGINX_HTTP_MEMCACHED=y
CONFIG_NGINX_HTTP_PROXY=y
CONFIG_NGINX_HTTP_REFERER=y
CONFIG_NGINX_HTTP_REWRITE=y
CONFIG_NGINX_HTTP_SCGI=y
CONFIG_NGINX_HTTP_SPLIT_CLIENTS=y
CONFIG_NGINX_HTTP_SSI=y
CONFIG_NGINX_HTTP_UPSTREAM_HASH=y
CONFIG_NGINX_HTTP_UPSTREAM_IP_HASH=y
CONFIG_NGINX_HTTP_UPSTREAM_KEEPALIVE=y
CONFIG_NGINX_HTTP_UPSTREAM_LEAST_CONN=y
CONFIG_NGINX_HTTP_USERID=y
CONFIG_NGINX_HTTP_UWSGI=y
CONFIG_NGINX_NAXSI=y
# CONFIG_NGINX_NOPCRE is not set
CONFIG_NGINX_PCRE=y
CONFIG_NGINX_UBUS=y
CONFIG_OCSERV_HTTP_PARSER=y
CONFIG_OCSERV_PROTOBUF=y
CONFIG_OPENVPN_openssl_ENABLE_DEF_AUTH=y
CONFIG_OPENVPN_openssl_ENABLE_FRAGMENT=y
CONFIG_OPENVPN_openssl_ENABLE_LZ4=y
CONFIG_OPENVPN_openssl_ENABLE_LZO=y
CONFIG_OPENVPN_openssl_ENABLE_MULTIHOME=y
CONFIG_OPENVPN_openssl_ENABLE_PF=y
CONFIG_OPENVPN_openssl_ENABLE_PORT_SHARE=y
CONFIG_OPENVPN_openssl_ENABLE_SERVER=y
CONFIG_OPENVPN_openssl_ENABLE_SMALL=y
CONFIG_PACKAGE_6in4=y
CONFIG_PACKAGE_MAC80211_DEBUGFS=y
CONFIG_PACKAGE_MAC80211_MESH=y
CONFIG_PACKAGE_NTFS-3G_HAS_PROBE=y
CONFIG_PACKAGE_SAMBA_MAX_DEBUG_LEVEL=-1
CONFIG_PACKAGE_adblock=m
CONFIG_PACKAGE_adbyby=y
CONFIG_PACKAGE_ahcpd=m
CONFIG_PACKAGE_alsa-lib=m
CONFIG_PACKAGE_alsa-utils=m
CONFIG_PACKAGE_amule=m
CONFIG_PACKAGE_antfs-mount=y
CONFIG_PACKAGE_aria2=y
CONFIG_PACKAGE_ariang=y
CONFIG_PACKAGE_attendedsysupgrade-common=m
CONFIG_PACKAGE_attr=m
CONFIG_PACKAGE_automount=y
CONFIG_PACKAGE_avahi-dbus-daemon=m
CONFIG_PACKAGE_baidupcs-web=y
CONFIG_PACKAGE_bash=y
CONFIG_PACKAGE_bcp38=m
CONFIG_PACKAGE_bird1-ipv4=m
CONFIG_PACKAGE_bird1-ipv4-uci=m
CONFIG_PACKAGE_bird1-ipv6=m
CONFIG_PACKAGE_bird1-ipv6-uci=m
CONFIG_PACKAGE_blkid=m
CONFIG_PACKAGE_bmx6=m
CONFIG_PACKAGE_boost-chrono=y
CONFIG_PACKAGE_boost-random=y
CONFIG_PACKAGE_brook=m
CONFIG_PACKAGE_btrfs-progs=y
CONFIG_PACKAGE_bzip2=y
CONFIG_PACKAGE_ca-bundle=y
CONFIG_PACKAGE_certtool=m
CONFIG_PACKAGE_cgi-io=m
CONFIG_PACKAGE_cgroupfs-mount=y
CONFIG_PACKAGE_cjdns=m
CONFIG_PACKAGE_clamav=m
CONFIG_PACKAGE_collectd=m
CONFIG_PACKAGE_collectd-mod-cpu=m
CONFIG_PACKAGE_collectd-mod-interface=m
CONFIG_PACKAGE_collectd-mod-iwinfo=m
CONFIG_PACKAGE_collectd-mod-load=m
CONFIG_PACKAGE_collectd-mod-memory=m
CONFIG_PACKAGE_collectd-mod-network=m
CONFIG_PACKAGE_collectd-mod-rrdtool=m
CONFIG_PACKAGE_confuse=m
CONFIG_PACKAGE_containerd=y
CONFIG_PACKAGE_coreutils-nohup=y
CONFIG_PACKAGE_coreutils-sort=m
CONFIG_PACKAGE_cshark=m
CONFIG_PACKAGE_curl=y
CONFIG_PACKAGE_dbus=m
CONFIG_PACKAGE_dkjson=m
CONFIG_PACKAGE_dnscrypt-proxy=m
CONFIG_PACKAGE_dnscrypt-proxy-resolvers=m
CONFIG_PACKAGE_dnsforwarder=m
CONFIG_PACKAGE_docker-ce=y
CONFIG_PACKAGE_dump1090=m
CONFIG_PACKAGE_dynapoint=m
CONFIG_PACKAGE_e2guardian=m
CONFIG_PACKAGE_fdisk=y
CONFIG_PACKAGE_fdk-aac=m
CONFIG_PACKAGE_flock=m
CONFIG_PACKAGE_forked-daapd=m
CONFIG_PACKAGE_freifunk-common=m
CONFIG_PACKAGE_freifunk-firewall=m
CONFIG_PACKAGE_freifunk-policyrouting=m
CONFIG_PACKAGE_frpc=y
CONFIG_PACKAGE_frps=y
CONFIG_PACKAGE_fuse-utils=m
CONFIG_PACKAGE_fwknopd=m
CONFIG_PACKAGE_getopt=m
CONFIG_PACKAGE_git=y
CONFIG_PACKAGE_haproxy=y
CONFIG_PACKAGE_hd-idle=m
CONFIG_PACKAGE_https-dns-proxy=y
CONFIG_PACKAGE_icu=y
CONFIG_PACKAGE_ip6tables=y
CONFIG_PACKAGE_iptables-mod-conntrack-extra=m
CONFIG_PACKAGE_iptables-mod-extra=y
CONFIG_PACKAGE_iptables-mod-filter=m
CONFIG_PACKAGE_iptables-mod-ipopt=m
CONFIG_PACKAGE_iptables-mod-ipsec=m
CONFIG_PACKAGE_iptables-mod-nat-extra=m
CONFIG_PACKAGE_ipv6helper=y
CONFIG_PACKAGE_kmod-br-netfilter=y
CONFIG_PACKAGE_kmod-crypto-acompress=y
CONFIG_PACKAGE_kmod-crypto-cbc=m
CONFIG_PACKAGE_kmod-crypto-ccm=m
CONFIG_PACKAGE_kmod-crypto-cmac=m
CONFIG_PACKAGE_kmod-crypto-crc32c=y
CONFIG_PACKAGE_kmod-crypto-ctr=m
CONFIG_PACKAGE_kmod-crypto-cts=m
CONFIG_PACKAGE_kmod-crypto-deflate=m
CONFIG_PACKAGE_kmod-crypto-des=m
CONFIG_PACKAGE_kmod-crypto-echainiv=m
CONFIG_PACKAGE_kmod-crypto-gcm=m
CONFIG_PACKAGE_kmod-crypto-gf128=m
CONFIG_PACKAGE_kmod-crypto-ghash=m
CONFIG_PACKAGE_kmod-crypto-hmac=m
CONFIG_PACKAGE_kmod-crypto-md4=m
CONFIG_PACKAGE_kmod-crypto-md5=m
CONFIG_PACKAGE_kmod-crypto-rng=m
CONFIG_PACKAGE_kmod-crypto-seqiv=m
CONFIG_PACKAGE_kmod-crypto-sha256=m
CONFIG_PACKAGE_kmod-crypto-sha512=m
CONFIG_PACKAGE_kmod-dax=y
CONFIG_PACKAGE_kmod-dm=y
CONFIG_PACKAGE_kmod-dnsresolver=m
CONFIG_PACKAGE_kmod-eeprom-93cx6=y
CONFIG_PACKAGE_kmod-fs-antfs=y
CONFIG_PACKAGE_kmod-fs-btrfs=y
CONFIG_PACKAGE_kmod-fs-cifs=m
CONFIG_PACKAGE_kmod-fs-exfat=y
CONFIG_PACKAGE_kmod-fs-exportfs=m
CONFIG_PACKAGE_kmod-fs-ext4=y
CONFIG_PACKAGE_kmod-fs-ksmbd=m
CONFIG_PACKAGE_kmod-fs-nfs=m
CONFIG_PACKAGE_kmod-fs-nfs-common=m
CONFIG_PACKAGE_kmod-fs-nfs-common-rpcsec=m
CONFIG_PACKAGE_kmod-fs-nfs-v4=m
CONFIG_PACKAGE_kmod-fs-nfsd=m
CONFIG_PACKAGE_kmod-fuse=y
CONFIG_PACKAGE_kmod-gre=m
CONFIG_PACKAGE_kmod-ifb=m
CONFIG_PACKAGE_kmod-ikconfig=y
CONFIG_PACKAGE_kmod-ip6-tunnel=m
CONFIG_PACKAGE_kmod-ipsec=m
CONFIG_PACKAGE_kmod-ipsec4=m
CONFIG_PACKAGE_kmod-ipsec6=m
CONFIG_PACKAGE_kmod-ipt-conntrack-extra=m
CONFIG_PACKAGE_kmod-ipt-extra=y
CONFIG_PACKAGE_kmod-ipt-filter=m
CONFIG_PACKAGE_kmod-ipt-ipopt=m
CONFIG_PACKAGE_kmod-ipt-ipsec=m
CONFIG_PACKAGE_kmod-ipt-nat-extra=m
CONFIG_PACKAGE_kmod-ipt-nat6=y
CONFIG_PACKAGE_kmod-ipt-offload=m
CONFIG_PACKAGE_kmod-iptunnel=y
CONFIG_PACKAGE_kmod-iptunnel4=y
CONFIG_PACKAGE_kmod-iptunnel6=m
CONFIG_PACKAGE_kmod-lib-crc16=y
CONFIG_PACKAGE_kmod-lib-crc32c=y
CONFIG_PACKAGE_kmod-lib-lzo=y
CONFIG_PACKAGE_kmod-lib-raid6=y
CONFIG_PACKAGE_kmod-lib-xor=y
CONFIG_PACKAGE_kmod-lib-zlib-deflate=y
CONFIG_PACKAGE_kmod-lib-zlib-inflate=y
CONFIG_PACKAGE_kmod-lib-zstd=y
CONFIG_PACKAGE_kmod-mac80211=y
CONFIG_PACKAGE_kmod-nf-flow=m
CONFIG_PACKAGE_kmod-nf-ipvs=y
CONFIG_PACKAGE_kmod-nf-nat6=y
CONFIG_PACKAGE_kmod-nft-bridge=m
CONFIG_PACKAGE_kmod-nft-core=m
CONFIG_PACKAGE_kmod-nft-netdev=m
CONFIG_PACKAGE_kmod-rt2800-lib=y
CONFIG_PACKAGE_kmod-rt2800-mmio=y
CONFIG_PACKAGE_kmod-rt2800-pci=y
CONFIG_PACKAGE_kmod-rt2800-usb=y
CONFIG_PACKAGE_kmod-rt2x00-lib=y
CONFIG_PACKAGE_kmod-rt2x00-mmio=y
CONFIG_PACKAGE_kmod-rt2x00-pci=y
CONFIG_PACKAGE_kmod-rt2x00-usb=y
CONFIG_PACKAGE_kmod-sched=m
CONFIG_PACKAGE_kmod-sched-cake=m
CONFIG_PACKAGE_kmod-sched-cake-virtual=m
CONFIG_PACKAGE_kmod-sched-connmark=m
CONFIG_PACKAGE_kmod-sched-core=m
CONFIG_PACKAGE_kmod-scsi-core=y
CONFIG_PACKAGE_kmod-siit=m
CONFIG_PACKAGE_kmod-sit=y
CONFIG_PACKAGE_kmod-tun=m
CONFIG_PACKAGE_kmod-udptunnel4=m
CONFIG_PACKAGE_kmod-udptunnel6=m
CONFIG_PACKAGE_kmod-usb-ehci=y
CONFIG_PACKAGE_kmod-usb-printer=m
CONFIG_PACKAGE_kmod-usb-storage=y
CONFIG_PACKAGE_kmod-usb-storage-extras=y
CONFIG_PACKAGE_kmod-usb-storage-uas=y
CONFIG_PACKAGE_kmod-usb2=y
CONFIG_PACKAGE_kmod-usb2-pci=y
CONFIG_PACKAGE_kmod-usb3=y
CONFIG_PACKAGE_kmod-veth=y
CONFIG_PACKAGE_kmod-wireguard=m
CONFIG_PACKAGE_ksmbd-server=m
CONFIG_PACKAGE_lame-lib=m
CONFIG_PACKAGE_libantlr3c=m
CONFIG_PACKAGE_libao=m
CONFIG_PACKAGE_libattr=y
CONFIG_PACKAGE_libavahi-client=m
CONFIG_PACKAGE_libavahi-compat-libdnssd=m
CONFIG_PACKAGE_libavahi-dbus-support=m
CONFIG_PACKAGE_libbfd=m
CONFIG_PACKAGE_libbz2=y
CONFIG_PACKAGE_libcap=y
CONFIG_PACKAGE_libconfig=m
CONFIG_PACKAGE_libcryptopp=m
CONFIG_PACKAGE_libcurl=y
CONFIG_PACKAGE_libdaemon=m
CONFIG_PACKAGE_libdb47=y
CONFIG_PACKAGE_libdbus=m
CONFIG_PACKAGE_libdevmapper=y
CONFIG_PACKAGE_libdouble-conversion=y
CONFIG_PACKAGE_libedit=m
CONFIG_PACKAGE_libexif=m
CONFIG_PACKAGE_libexpat=m
CONFIG_PACKAGE_libfdisk=y
CONFIG_PACKAGE_libffi=y
CONFIG_PACKAGE_libffmpeg-full=m
CONFIG_PACKAGE_libfko=m
CONFIG_PACKAGE_libflac=m
CONFIG_PACKAGE_libfreetype=m
CONFIG_PACKAGE_libfuse=m
CONFIG_PACKAGE_libgcrypt=m
CONFIG_PACKAGE_libgd=m
CONFIG_PACKAGE_libgd-full=m
CONFIG_PACKAGE_libgdbm=y
CONFIG_PACKAGE_libgmp=m
CONFIG_PACKAGE_libgnutls=m
CONFIG_PACKAGE_libgpg-error=m
CONFIG_PACKAGE_libiconv-full=m
CONFIG_PACKAGE_libid3tag=m
CONFIG_PACKAGE_libjpeg-turbo=m
CONFIG_PACKAGE_libkeyutils=m
CONFIG_PACKAGE_libltdl=y
CONFIG_PACKAGE_liblua5.3=y
CONFIG_PACKAGE_liblxc=m
CONFIG_PACKAGE_liblzma=y
CONFIG_PACKAGE_liblzo=y
CONFIG_PACKAGE_libmilter-sendmail=m
CONFIG_PACKAGE_libminiupnpc=m
CONFIG_PACKAGE_libmount=y
CONFIG_PACKAGE_libnatpmp=m
CONFIG_PACKAGE_libncurses=y
CONFIG_PACKAGE_libnetfilter-conntrack=m
CONFIG_PACKAGE_libnettle=m
CONFIG_PACKAGE_libnetwork=y
CONFIG_PACKAGE_libnfnetlink=m
CONFIG_PACKAGE_libnftnl=m
CONFIG_PACKAGE_libnl-core=m
CONFIG_PACKAGE_libnl-genl=m
CONFIG_PACKAGE_libogg=m
CONFIG_PACKAGE_libopus=m
CONFIG_PACKAGE_libpagekite=m
CONFIG_PACKAGE_libpam=m
CONFIG_PACKAGE_libpcap=m
CONFIG_PACKAGE_libpcre2=m
CONFIG_PACKAGE_libpcre2-16=y
CONFIG_PACKAGE_libplist=m
CONFIG_PACKAGE_libpng=m
CONFIG_PACKAGE_libpopt=m
CONFIG_PACKAGE_libprotobuf-c=m
CONFIG_PACKAGE_libqrencode=m
CONFIG_PACKAGE_libreadline=y
CONFIG_PACKAGE_librrd1=m
CONFIG_PACKAGE_librtlsdr=m
CONFIG_PACKAGE_libseccomp=m
CONFIG_PACKAGE_libsoxr=m
CONFIG_PACKAGE_libsqlite3=y
CONFIG_PACKAGE_libtasn1=m
CONFIG_PACKAGE_libtiff=m
CONFIG_PACKAGE_libtins=m
CONFIG_PACKAGE_libtirpc=m
CONFIG_PACKAGE_libubox-lua=m
CONFIG_PACKAGE_libunbound=m
CONFIG_PACKAGE_libunbound_ipset=y
CONFIG_PACKAGE_libunbound_libevent=y
CONFIG_PACKAGE_libunbound_libpthread=y
CONFIG_PACKAGE_libunistring=m
CONFIG_PACKAGE_libupnp=m
CONFIG_PACKAGE_libusb-1.0=m
CONFIG_PACKAGE_libustream-mbedtls=m
CONFIG_PACKAGE_libvorbis=m
CONFIG_PACKAGE_libwebp=m
CONFIG_PACKAGE_libwebsockets-full=y
CONFIG_PACKAGE_libwrap=m
CONFIG_PACKAGE_libwxbase=m
CONFIG_PACKAGE_libxml2=y
CONFIG_PACKAGE_libyaml=y
CONFIG_PACKAGE_libyaml-cpp=m
CONFIG_PACKAGE_libzip-gnutls=m
CONFIG_PACKAGE_libzstd=y
CONFIG_PACKAGE_lua-bencode=m
CONFIG_PACKAGE_lua-sha2=m
CONFIG_PACKAGE_luasocket=m
CONFIG_PACKAGE_luci-app-adblock=m
CONFIG_PACKAGE_luci-app-adbyby-plus=y
CONFIG_PACKAGE_luci-app-advanced-reboot=y
CONFIG_PACKAGE_luci-app-ahcp=m
CONFIG_PACKAGE_luci-app-airplay2=m
CONFIG_PACKAGE_luci-app-amule=m
CONFIG_PACKAGE_luci-app-aria2=y
CONFIG_PACKAGE_luci-app-asterisk=m
CONFIG_PACKAGE_luci-app-attendedsysupgrade=m
CONFIG_PACKAGE_luci-app-baidupcs-web=y
CONFIG_PACKAGE_luci-app-bcp38=m
CONFIG_PACKAGE_luci-app-bird1-ipv4=m
CONFIG_PACKAGE_luci-app-bird1-ipv6=m
CONFIG_PACKAGE_luci-app-bmx6=m
CONFIG_PACKAGE_luci-app-brook-server=m
CONFIG_PACKAGE_luci-app-cifs-mount=m
CONFIG_PACKAGE_luci-app-cifsd=m
CONFIG_PACKAGE_luci-app-cjdns=m
CONFIG_PACKAGE_luci-app-clamav=m
CONFIG_PACKAGE_luci-app-commands=m
CONFIG_PACKAGE_luci-app-control-timewol=m
CONFIG_PACKAGE_luci-app-control-webrestriction=m
CONFIG_PACKAGE_luci-app-control-weburl=m
CONFIG_PACKAGE_luci-app-cshark=m
CONFIG_PACKAGE_luci-app-diag-core=m
CONFIG_PACKAGE_luci-app-diskman=m
CONFIG_PACKAGE_luci-app-dnscrypt-proxy=m
CONFIG_PACKAGE_luci-app-dnsforwarder=m
CONFIG_PACKAGE_luci-app-docker=y
CONFIG_PACKAGE_luci-app-dump1090=m
CONFIG_PACKAGE_luci-app-dynapoint=m
CONFIG_PACKAGE_luci-app-e2guardian=m
CONFIG_PACKAGE_luci-app-familycloud=m
CONFIG_PACKAGE_luci-app-fileassistant=m
CONFIG_PACKAGE_luci-app-filebrowser=y
CONFIG_PACKAGE_luci-app-flowoffload=m
CONFIG_PACKAGE_luci-app-freifunk-diagnostics=m
CONFIG_PACKAGE_luci-app-freifunk-policyrouting=m
CONFIG_PACKAGE_luci-app-freifunk-widgets=m
CONFIG_PACKAGE_luci-app-frpc=y
CONFIG_PACKAGE_luci-app-frps=y
CONFIG_PACKAGE_luci-app-fwknopd=m
CONFIG_PACKAGE_luci-app-guest-wifi=m
CONFIG_PACKAGE_luci-app-haproxy-tcp=m
CONFIG_PACKAGE_luci-app-hd-idle=m
CONFIG_PACKAGE_luci-app-hnet=m
CONFIG_PACKAGE_luci-app-https-dns-proxy=m
CONFIG_PACKAGE_luci-app-ipsec-vpnd=m
CONFIG_PACKAGE_luci-app-ipsec-vpnserver-manyusers=m
CONFIG_PACKAGE_luci-app-kcptun=m
CONFIG_PACKAGE_luci-app-kodexplorer=m
CONFIG_PACKAGE_luci-app-lxc=m
CONFIG_PACKAGE_luci-app-meshwizard=m
CONFIG_PACKAGE_luci-app-minidlna=m
CONFIG_PACKAGE_luci-app-mjpg-streamer=m
CONFIG_PACKAGE_luci-app-music-remote-center=m
CONFIG_PACKAGE_luci-app-mwan3=m
CONFIG_PACKAGE_luci-app-mwan3helper=m
CONFIG_PACKAGE_luci-app-n2n_v2=m
CONFIG_PACKAGE_luci-app-netdata=y
CONFIG_PACKAGE_luci-app-nfs=m
CONFIG_PACKAGE_luci-app-nft-qos=m
CONFIG_PACKAGE_luci-app-nginx-pingos=m
CONFIG_PACKAGE_luci-app-noddos=m
CONFIG_PACKAGE_luci-app-nps=m
CONFIG_PACKAGE_luci-app-ntpc=m
CONFIG_PACKAGE_luci-app-ocserv=m
CONFIG_PACKAGE_luci-app-olsr=m
CONFIG_PACKAGE_luci-app-olsr-services=m
CONFIG_PACKAGE_luci-app-olsr-viz=m
CONFIG_PACKAGE_luci-app-openvpn=m
CONFIG_PACKAGE_luci-app-openvpn-server=m
CONFIG_PACKAGE_luci-app-p910nd=m
CONFIG_PACKAGE_luci-app-pagekitec=m
CONFIG_PACKAGE_luci-app-passwall=y
CONFIG_PACKAGE_luci-app-polipo=m
CONFIG_PACKAGE_luci-app-pppoe-relay=m
CONFIG_PACKAGE_luci-app-pppoe-server=m
CONFIG_PACKAGE_luci-app-pptp-vpnserver-manyusers=m
CONFIG_PACKAGE_luci-app-privoxy=m
CONFIG_PACKAGE_luci-app-ps3netsrv=m
CONFIG_PACKAGE_luci-app-qbittorrent=y
CONFIG_PACKAGE_luci-app-qos=m
CONFIG_PACKAGE_luci-app-radicale=m
CONFIG_PACKAGE_luci-app-rclone=m
CONFIG_PACKAGE_luci-app-rp-pppoe-server=m
CONFIG_PACKAGE_luci-app-samba=m
CONFIG_PACKAGE_luci-app-samba4=m
CONFIG_PACKAGE_luci-app-shadowsocks-libev=m
CONFIG_PACKAGE_luci-app-shairplay=m
CONFIG_PACKAGE_luci-app-siitwizard=m
CONFIG_PACKAGE_luci-app-simple-adblock=m
CONFIG_PACKAGE_luci-app-socat=m
CONFIG_PACKAGE_luci-app-softethervpn=m
CONFIG_PACKAGE_luci-app-splash=m
CONFIG_PACKAGE_luci-app-sqm=m
CONFIG_PACKAGE_luci-app-squid=m
CONFIG_PACKAGE_luci-app-ssr-libev-server=m
CONFIG_PACKAGE_luci-app-ssr-mudb-server=m
CONFIG_PACKAGE_luci-app-ssrserver-python=m
CONFIG_PACKAGE_luci-app-statistics=m
CONFIG_PACKAGE_luci-app-syncdial=m
CONFIG_PACKAGE_luci-app-syncthing=m
CONFIG_PACKAGE_luci-app-timecontrol=m
CONFIG_PACKAGE_luci-app-tinyproxy=m
CONFIG_PACKAGE_luci-app-transmission=m
CONFIG_PACKAGE_luci-app-travelmate=m
CONFIG_PACKAGE_luci-app-trojan-server=m
CONFIG_PACKAGE_luci-app-ttyd=y
CONFIG_PACKAGE_luci-app-udpxy=m
CONFIG_PACKAGE_luci-app-uhttpd=y
CONFIG_PACKAGE_luci-app-unbound=m
CONFIG_PACKAGE_luci-app-usb-printer=m
CONFIG_PACKAGE_luci-app-v2ray-server=m
CONFIG_PACKAGE_luci-app-verysync=m
CONFIG_PACKAGE_luci-app-vnstat=m
CONFIG_PACKAGE_luci-app-vpnbypass=m
CONFIG_PACKAGE_luci-app-watchcat=m
CONFIG_PACKAGE_luci-app-wifischedule=m
CONFIG_PACKAGE_luci-app-wireguard=m
CONFIG_PACKAGE_luci-app-wrtbwmon=m
CONFIG_PACKAGE_luci-app-xlnetacc=m
CONFIG_PACKAGE_luci-app-zerotier=m
CONFIG_PACKAGE_luci-i18n-adblock-zh-cn=m
CONFIG_PACKAGE_luci-i18n-adbyby-plus-zh-cn=y
CONFIG_PACKAGE_luci-i18n-advanced-reboot-zh-cn=y
CONFIG_PACKAGE_luci-i18n-ahcp-zh-cn=m
CONFIG_PACKAGE_luci-i18n-airplay2-zh-cn=m
CONFIG_PACKAGE_luci-i18n-amule-zh-cn=m
CONFIG_PACKAGE_luci-i18n-aria2-zh-cn=y
CONFIG_PACKAGE_luci-i18n-asterisk-zh-cn=m
CONFIG_PACKAGE_luci-i18n-bcp38-zh-cn=m
CONFIG_PACKAGE_luci-i18n-brook-server-zh-cn=m
CONFIG_PACKAGE_luci-i18n-cifs-mount-zh-cn=m
CONFIG_PACKAGE_luci-i18n-cifsd-zh-cn=m
CONFIG_PACKAGE_luci-i18n-clamav-zh-cn=m
CONFIG_PACKAGE_luci-i18n-commands-zh-cn=m
CONFIG_PACKAGE_luci-i18n-control-timewol-zh-cn=m
CONFIG_PACKAGE_luci-i18n-control-webrestriction-zh-cn=m
CONFIG_PACKAGE_luci-i18n-control-weburl-zh-cn=m
CONFIG_PACKAGE_luci-i18n-diag-core-zh-cn=m
CONFIG_PACKAGE_luci-i18n-dnsforwarder-zh-cn=m
CONFIG_PACKAGE_luci-i18n-docker-zh-cn=y
CONFIG_PACKAGE_luci-i18n-filebrowser-zh-cn=y
CONFIG_PACKAGE_luci-i18n-flowoffload-zh-cn=m
CONFIG_PACKAGE_luci-i18n-freifunk-policyrouting-zh-cn=m
CONFIG_PACKAGE_luci-i18n-freifunk-zh-cn=m
CONFIG_PACKAGE_luci-i18n-frpc-zh-cn=y
CONFIG_PACKAGE_luci-i18n-frps-zh-cn=y
CONFIG_PACKAGE_luci-i18n-guest-wifi-zh-cn=m
CONFIG_PACKAGE_luci-i18n-haproxy-tcp-zh-cn=m
CONFIG_PACKAGE_luci-i18n-hd-idle-zh-cn=m
CONFIG_PACKAGE_luci-i18n-ipsec-vpnd-zh-cn=m
CONFIG_PACKAGE_luci-i18n-ipsec-vpnserver-manyusers-zh-cn=m
CONFIG_PACKAGE_luci-i18n-kcptun-zh-cn=m
CONFIG_PACKAGE_luci-i18n-kodexplorer-zh-cn=m
CONFIG_PACKAGE_luci-i18n-meshwizard-zh-cn=m
CONFIG_PACKAGE_luci-i18n-minidlna-zh-cn=m
CONFIG_PACKAGE_luci-i18n-mjpg-streamer-zh-cn=m
CONFIG_PACKAGE_luci-i18n-music-remote-center-zh-cn=m
CONFIG_PACKAGE_luci-i18n-mwan3-zh-cn=m
CONFIG_PACKAGE_luci-i18n-mwan3helper-zh-cn=m
CONFIG_PACKAGE_luci-i18n-n2n_v2-zh-cn=m
CONFIG_PACKAGE_luci-i18n-netdata-zh-cn=y
CONFIG_PACKAGE_luci-i18n-nfs-zh-cn=m
CONFIG_PACKAGE_luci-i18n-nft-qos-zh-cn=m
CONFIG_PACKAGE_luci-i18n-nps-zh-cn=m
CONFIG_PACKAGE_luci-i18n-ntpc-zh-cn=m
CONFIG_PACKAGE_luci-i18n-olsr-zh-cn=m
CONFIG_PACKAGE_luci-i18n-openvpn-server-zh-cn=m
CONFIG_PACKAGE_luci-i18n-openvpn-zh-cn=m
CONFIG_PACKAGE_luci-i18n-p910nd-zh-cn=m
CONFIG_PACKAGE_luci-i18n-polipo-zh-cn=m
CONFIG_PACKAGE_luci-i18n-pppoe-relay-zh-cn=m
CONFIG_PACKAGE_luci-i18n-pppoe-server-zh-cn=m
CONFIG_PACKAGE_luci-i18n-pptp-vpnserver-manyusers-zh-cn=m
CONFIG_PACKAGE_luci-i18n-privoxy-zh-cn=m
CONFIG_PACKAGE_luci-i18n-ps3netsrv-zh-cn=m
CONFIG_PACKAGE_luci-i18n-qbittorrent-zh-cn=y
CONFIG_PACKAGE_luci-i18n-qos-zh-cn=m
CONFIG_PACKAGE_luci-i18n-rclone-zh-cn=m
CONFIG_PACKAGE_luci-i18n-samba-zh-cn=m
CONFIG_PACKAGE_luci-i18n-samba4-zh-cn=m
CONFIG_PACKAGE_luci-i18n-socat-zh-cn=m
CONFIG_PACKAGE_luci-i18n-softethervpn-zh-cn=m
CONFIG_PACKAGE_luci-i18n-splash-zh-cn=m
CONFIG_PACKAGE_luci-i18n-sqm-zh-cn=m
CONFIG_PACKAGE_luci-i18n-ssr-libev-server-zh-cn=m
CONFIG_PACKAGE_luci-i18n-ssr-mudb-server-zh-cn=m
CONFIG_PACKAGE_luci-i18n-ssrserver-python-zh-cn=m
CONFIG_PACKAGE_luci-i18n-statistics-zh-cn=m
CONFIG_PACKAGE_luci-i18n-syncthing-zh-cn=m
CONFIG_PACKAGE_luci-i18n-timecontrol-zh-cn=m
CONFIG_PACKAGE_luci-i18n-tinyproxy-zh-cn=m
CONFIG_PACKAGE_luci-i18n-transmission-zh-cn=m
CONFIG_PACKAGE_luci-i18n-trojan-server-zh-cn=m
CONFIG_PACKAGE_luci-i18n-ttyd-zh-cn=y
CONFIG_PACKAGE_luci-i18n-uhttpd-zh-cn=y
CONFIG_PACKAGE_luci-i18n-usb-printer-zh-cn=m
CONFIG_PACKAGE_luci-i18n-v2ray-server-zh-cn=m
CONFIG_PACKAGE_luci-i18n-verysync-zh-cn=m
CONFIG_PACKAGE_luci-i18n-vnstat-zh-cn=m
CONFIG_PACKAGE_luci-i18n-vpnbypass-zh-cn=m
CONFIG_PACKAGE_luci-i18n-watchcat-zh-cn=m
CONFIG_PACKAGE_luci-i18n-wifischedule-zh-cn=m
CONFIG_PACKAGE_luci-i18n-wireguard-zh-cn=m
CONFIG_PACKAGE_luci-i18n-wrtbwmon-zh-cn=m
CONFIG_PACKAGE_luci-i18n-zerotier-zh-cn=m
CONFIG_PACKAGE_luci-lib-dracula=m
CONFIG_PACKAGE_luci-lib-httpclient=m
CONFIG_PACKAGE_luci-lib-httpprotoutils=m
CONFIG_PACKAGE_luci-lib-jquery-1-4=m
CONFIG_PACKAGE_luci-lib-json=m
CONFIG_PACKAGE_luci-lib-luaneightbl=m
CONFIG_PACKAGE_luci-mod-freifunk=m
CONFIG_PACKAGE_luci-proto-ipv6=y
CONFIG_PACKAGE_luci-proto-wireguard=m
CONFIG_PACKAGE_luci-ssl-nginx=y
CONFIG_PACKAGE_luci-theme-argon=y
CONFIG_PACKAGE_luci-theme-freifunk-generic=y
CONFIG_PACKAGE_luci-theme-material=y
CONFIG_PACKAGE_luci-theme-netgear=y
CONFIG_PACKAGE_lxc=m
CONFIG_PACKAGE_lxc-attach=m
CONFIG_PACKAGE_lxc-common=m
CONFIG_PACKAGE_lxc-configs=m
CONFIG_PACKAGE_lxc-console=m
CONFIG_PACKAGE_lxc-create=m
CONFIG_PACKAGE_lxc-hooks=m
CONFIG_PACKAGE_lxc-templates=m
CONFIG_PACKAGE_meshwizard=m
CONFIG_PACKAGE_minidlna=m
CONFIG_PACKAGE_mjpg-streamer=m
CONFIG_PACKAGE_mount-utils=y
CONFIG_PACKAGE_musl-fts=m
CONFIG_PACKAGE_mwan3=m
CONFIG_PACKAGE_mxml=m
CONFIG_PACKAGE_n2n-edge=m
CONFIG_PACKAGE_n2n-supernode=m
CONFIG_PACKAGE_netdata=y
CONFIG_PACKAGE_nfs-kernel-server=m
CONFIG_PACKAGE_nfs-kernel-server-utils=m
CONFIG_PACKAGE_nfs-utils=m
CONFIG_PACKAGE_nfs-utils-libs=m
CONFIG_PACKAGE_nft-qos=m
CONFIG_PACKAGE_nftables-nojson=m
CONFIG_PACKAGE_nginx-mod-luci-ssl=y
CONFIG_PACKAGE_nginx-ssl=y
CONFIG_PACKAGE_nginx-ssl-util=y
CONFIG_PACKAGE_noddos=m
CONFIG_PACKAGE_npc=m
CONFIG_PACKAGE_ntfs-3g=y
CONFIG_PACKAGE_ntpclient=m
CONFIG_PACKAGE_ocserv=m
CONFIG_PACKAGE_odhcp6c=y
CONFIG_PACKAGE_odhcp6c_ext_cer_id=0
CONFIG_PACKAGE_odhcpd-ipv6only=y
CONFIG_PACKAGE_odhcpd_ipv6only_ext_cer_id=0
CONFIG_PACKAGE_olsrd=m
CONFIG_PACKAGE_olsrd-mod-jsoninfo=m
CONFIG_PACKAGE_olsrd-mod-nameservice=m
CONFIG_PACKAGE_olsrd-mod-txtinfo=m
CONFIG_PACKAGE_oniguruma=m
CONFIG_PACKAGE_openvpn-easy-rsa=m
CONFIG_PACKAGE_openvpn-openssl=m
CONFIG_PACKAGE_p910nd=m
CONFIG_PACKAGE_pagekitec=m
CONFIG_PACKAGE_parted=m
CONFIG_PACKAGE_php7=m
CONFIG_PACKAGE_php7-fpm=m
CONFIG_PACKAGE_php7-mod-curl=m
CONFIG_PACKAGE_php7-mod-gd=m
CONFIG_PACKAGE_php7-mod-iconv=m
CONFIG_PACKAGE_php7-mod-json=m
CONFIG_PACKAGE_php7-mod-mbstring=m
CONFIG_PACKAGE_php7-mod-mysqlnd=m
CONFIG_PACKAGE_php7-mod-opcache=m
CONFIG_PACKAGE_php7-mod-pdo=m
CONFIG_PACKAGE_php7-mod-pdo-mysql=m
CONFIG_PACKAGE_php7-mod-pdo-sqlite=m
CONFIG_PACKAGE_php7-mod-session=m
CONFIG_PACKAGE_php7-mod-sqlite3=m
CONFIG_PACKAGE_php7-mod-zip=m
CONFIG_PACKAGE_polipo=m
CONFIG_PACKAGE_pptpd=m
CONFIG_PACKAGE_privoxy=m
CONFIG_PACKAGE_ps3netsrv=m
CONFIG_PACKAGE_python-pip-conf=y
CONFIG_PACKAGE_python3=y
CONFIG_PACKAGE_python3-asyncio=y
CONFIG_PACKAGE_python3-base=y
CONFIG_PACKAGE_python3-certifi=y
CONFIG_PACKAGE_python3-cgi=y
CONFIG_PACKAGE_python3-cgitb=y
CONFIG_PACKAGE_python3-chardet=y
CONFIG_PACKAGE_python3-codecs=y
CONFIG_PACKAGE_python3-ctypes=y
CONFIG_PACKAGE_python3-dbm=y
CONFIG_PACKAGE_python3-decimal=y
CONFIG_PACKAGE_python3-distutils=y
CONFIG_PACKAGE_python3-email=y
CONFIG_PACKAGE_python3-gdbm=y
CONFIG_PACKAGE_python3-idna=y
CONFIG_PACKAGE_python3-light=y
CONFIG_PACKAGE_python3-logging=y
CONFIG_PACKAGE_python3-lzma=y
CONFIG_PACKAGE_python3-multiprocessing=y
CONFIG_PACKAGE_python3-ncurses=y
CONFIG_PACKAGE_python3-openssl=y
CONFIG_PACKAGE_python3-pip=y
CONFIG_PACKAGE_python3-pkg-resources=y
CONFIG_PACKAGE_python3-pydoc=y
CONFIG_PACKAGE_python3-requests=y
CONFIG_PACKAGE_python3-setuptools=y
CONFIG_PACKAGE_python3-sqlite3=y
CONFIG_PACKAGE_python3-unittest=y
CONFIG_PACKAGE_python3-urllib=y
CONFIG_PACKAGE_python3-urllib3=y
CONFIG_PACKAGE_python3-xml=y
CONFIG_PACKAGE_python3-yaml=y
CONFIG_PACKAGE_qBittorrent=y
CONFIG_PACKAGE_qos-scripts=m
CONFIG_PACKAGE_qrencode=m
CONFIG_PACKAGE_qt5-core=y
CONFIG_PACKAGE_qt5-network=y
CONFIG_PACKAGE_qt5-xml=y
CONFIG_PACKAGE_rblibtorrent=y
CONFIG_PACKAGE_rclone=m
CONFIG_PACKAGE_rclone-ng=m
CONFIG_PACKAGE_rclone-webui-react=m
CONFIG_PACKAGE_rp-pppoe-common=m
CONFIG_PACKAGE_rp-pppoe-relay=m
CONFIG_PACKAGE_rp-pppoe-server=m
CONFIG_PACKAGE_rpcbind=m
CONFIG_PACKAGE_rpcd-mod-lxc=m
CONFIG_PACKAGE_rpcd-mod-rpcsys=m
CONFIG_PACKAGE_rrdtool1=m
CONFIG_PACKAGE_rt2800-pci-firmware=y
CONFIG_PACKAGE_rt2800-usb-firmware=y
CONFIG_PACKAGE_runc=y
CONFIG_PACKAGE_samba36-server=m
CONFIG_PACKAGE_samba4-libs=m
CONFIG_PACKAGE_samba4-server=m
CONFIG_PACKAGE_screen=y
CONFIG_PACKAGE_shadowsocks-libev-ss-server=y
CONFIG_PACKAGE_shairplay=m
CONFIG_PACKAGE_shairport-sync-openssl=m
CONFIG_PACKAGE_simple-adblock=m
CONFIG_PACKAGE_smartmontools=m
CONFIG_PACKAGE_socat=m
CONFIG_PACKAGE_softethervpn5-bridge=m
CONFIG_PACKAGE_softethervpn5-client=m
CONFIG_PACKAGE_softethervpn5-libs=m
CONFIG_PACKAGE_softethervpn5-server=m
CONFIG_PACKAGE_sqlite3-cli=m
CONFIG_PACKAGE_sqm-scripts=m
CONFIG_PACKAGE_squid=m
CONFIG_PACKAGE_ssocks=y
CONFIG_PACKAGE_strongswan=m
CONFIG_PACKAGE_strongswan-charon=m
CONFIG_PACKAGE_strongswan-ipsec=m
CONFIG_PACKAGE_strongswan-minimal=m
CONFIG_PACKAGE_strongswan-mod-aes=m
CONFIG_PACKAGE_strongswan-mod-gmp=m
CONFIG_PACKAGE_strongswan-mod-hmac=m
CONFIG_PACKAGE_strongswan-mod-kernel-libipsec=m
CONFIG_PACKAGE_strongswan-mod-kernel-netlink=m
CONFIG_PACKAGE_strongswan-mod-nonce=m
CONFIG_PACKAGE_strongswan-mod-pubkey=m
CONFIG_PACKAGE_strongswan-mod-random=m
CONFIG_PACKAGE_strongswan-mod-sha1=m
CONFIG_PACKAGE_strongswan-mod-socket-default=m
CONFIG_PACKAGE_strongswan-mod-stroke=m
CONFIG_PACKAGE_strongswan-mod-updown=m
CONFIG_PACKAGE_strongswan-mod-x509=m
CONFIG_PACKAGE_strongswan-mod-xauth-generic=m
CONFIG_PACKAGE_strongswan-mod-xcbc=m
CONFIG_PACKAGE_syncthing=m
CONFIG_PACKAGE_tc=m
CONFIG_PACKAGE_terminfo=y
CONFIG_PACKAGE_tini=y
CONFIG_PACKAGE_tinyproxy=m
CONFIG_PACKAGE_transmission-daemon-openssl=m
CONFIG_PACKAGE_transmission-web-control=m
CONFIG_PACKAGE_travelmate=m
CONFIG_PACKAGE_trojan-go=y
CONFIG_PACKAGE_trojan-plus=y
CONFIG_PACKAGE_ttyd=y
CONFIG_PACKAGE_uclibcxx=m
CONFIG_PACKAGE_udpxy=m
CONFIG_PACKAGE_unbound-daemon=m
CONFIG_PACKAGE_unzip=y
CONFIG_PACKAGE_uwsgi=y
CONFIG_PACKAGE_uwsgi-cgi-plugin=y
CONFIG_PACKAGE_uwsgi-luci-support=y
CONFIG_PACKAGE_uwsgi-syslog-plugin=y
CONFIG_PACKAGE_verysync=m
CONFIG_PACKAGE_vim-full=y
CONFIG_PACKAGE_vnstat=m
CONFIG_PACKAGE_vnstati=m
CONFIG_PACKAGE_vpnbypass=m
CONFIG_PACKAGE_watchcat=m
CONFIG_PACKAGE_webui-aria2=y
CONFIG_PACKAGE_wifischedule=m
CONFIG_PACKAGE_wireguard-tools=y
CONFIG_PACKAGE_wsdd2=m
CONFIG_PACKAGE_zerotier=m
CONFIG_PACKAGE_zoneinfo-asia=m
CONFIG_PACKAGE_zsh=y
CONFIG_RPCBIND_LIBWRAP=y
CONFIG_RPCBIND_RMTCALLS=y
CONFIG_SAMBA4_SERVER_AVAHI=y
CONFIG_SAMBA4_SERVER_NETBIOS=y
CONFIG_SAMBA4_SERVER_VFS=y
CONFIG_SQLITE3_DYNAMIC_EXTENSIONS=y
CONFIG_SQLITE3_FTS3=y
CONFIG_SQLITE3_FTS4=y
CONFIG_SQLITE3_FTS5=y
CONFIG_SQLITE3_JSON1=y
CONFIG_SQLITE3_LIBEDIT=y
CONFIG_SQLITE3_RTREE=y
CONFIG_SQUID_enable-dlmalloc=y
CONFIG_SQUID_enable-ipv6=y
CONFIG_SQUID_use-openssl=y
CONFIG_STRONGSWAN_ROUTING_TABLE="220"
CONFIG_STRONGSWAN_ROUTING_TABLE_PRIO="220"
CONFIG_TARGET_KERNEL_PARTSIZE=50
CONFIG_TARGET_ROOTFS_PARTSIZE=500
CONFIG_TARGET_ROOTFS_TARGZ=y
CONFIG_TROJAN_GO_COMPRESS_UPX=y
CONFIG_ZSTD_OPTIMIZE_O3=y
```
